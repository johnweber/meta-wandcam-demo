## conf/layer.conf
```bitbake
# We have a conf and classes directory, add to BBPATH
BBPATH .= ":${LAYERDIR}"

# We have a packages directory, add to BBFILES
BBFILES += "${LAYERDIR}/recipes-*/*/*.bb \
            ${LAYERDIR}/recipes-*/*/*.bbappend"

BBFILE_COLLECTIONS += "wandcam-demo"
BBFILE_PATTERN_wandcam-demo := "^${LAYERDIR}/"
BBFILE_PRIORITY_wandcam-demo = "6"
```
